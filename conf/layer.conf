## conf/layer.conf
```bitbake
# We have a conf and classes directory, add to BBPATH
BBPATH .= ":${LAYERDIR}"

# We have recipes-* directories, add to BBFILES
BBFILES += "${LAYERDIR}/recipes-*/*/*.bb \
            ${LAYERDIR}/recipes-*/*/*.bbappend \
            ${LAYERDIR}/openembedded-core/meta/recipes-*/*/*.bb \
            ${LAYERDIR}/openembedded-core/meta/recipes-*/*/*.bbappend \
"

BBFILE_COLLECTIONS += "meta-dac"
BBFILE_PATTERN_meta-dac = "^${LAYERDIR}/"
BBFILE_PRIORITY_meta-dac = "6"

LAYERDEPENDS_meta-dac = "core"
LAYERSERIES_COMPAT_meta-dac = "dunfell"

DISTRO_FEATURES_remove = " x11"
DISTRO_FEATURES_remove = " kde"
DISTRO_FEATURES_remove = " vulkan"
DISTRO_FEATURES_remove = " bluetooth"
DISTRO_FEATURES_append = " egl"
DISTRO_FEATURES_append = " opengles2"

PACKAGECONFIG_remove_pn-cairo = " opengl"
PACKAGECONFIG_remove_pn-qtbase = " gbm"

PREFERRED_VERSION_libepoxy = "1.5.3"

# Force Gstreamer 10.0.4
# mask gstreamer from dunfell
BBMASK += "/meta/recipes-multimedia/gstreamer"
BBMASK += "/meta-raspberrypi/recipes-multimedia/gstreamer/"
# use gstreamer  from meta-gstreamer1.0
PREFERRED_VERSION_gstreamer1.0 = "1.10.4"
# gstreamer 1.10.4 use some old libraries
PREFERRED_VERSION_glib-2 = "0_2.48.2"
PREFERRED_VERSION_gobject-introspection = "1.48.0"
PREFERRED_VERSION_gnome-desktop-testing = "2014.1"
PREFERRED_VERSION_pango = "1.40.1"

# Cobalt application from rdk
# mask all unnecessary recipes from meta-rdk-video
BBMASK += "/meta-rdk-video/recipes-common/"
BBMASK += "/meta-rdk-video/recipes-core/"
BBMASK += "/meta-rdk-video/recipes-extended/(?!cobalt)"
BBMASK += "/meta-rdk-video/recipes-graphics/"
BBMASK += "/meta-rdk-video/recipes-multimedia/"
BBMASK += "/meta-rdk-video/recipes-oem/"
BBMASK += "/meta-rdk-video/recipes-qt/"
BBMASK += "/meta-rdk-video/recipes-support/"
BBMASK += "/meta-rdk-video/recipes-thirdparty/"
```
